/*
  Text flow on LED matrix 8x8

 Hardware required :
 * LED matrix 8x8
 * 8x resistor 330
 * Arduino UNO

 v 0.1.0 - Martin Mikala, May 2, 2016
 Part of code from Arduino book - Průvodce světem Arduina, http://arduino.cz/
 
 ASCII font 5x7 from https://www.ccsinfo.com/forum/viewtopic.php?p=34689

*/

// ASCII font array
// rows -> {1,2,3,4,5,6,7,8}
// column 0x00 -> 0xFF
// 128 characters
  byte font[128][8] =
   {{0,0,0,0,0,0,0,0},                        //0x00  
    {0,0,0,0,0,0,0,0},                        //0x01
    {0,0,0,0,0,0,0,0},                        //0x02
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   {0x1f, 0x1f, 0x1f, 0x1f, 0x1f, 0x1f, 0x1f, 0x00}    // 0x7f, DEL
   };

byte columns[] = {2,3,4,5,6,7,8,9};                        //pins for columns 1-8
byte rows[] = {A5,A4,A3,A2,A1,A0,10,11};                   //pins for rows 1-8
boolean rowon = LOW;                                       // row bit on/off value
boolean rowoff = HIGH;
boolean colon = HIGH;                                      // column bit on/off value
boolean coloff = LOW;
String text = "Hello world!  ";                              // TEXT for FLOW 

//LED matrix memory
byte matrix[8] = {0,0,0,0,0,0,0,0};

   
void setup(){
  for(int i = 0; i < 8; i++){
  //set pins
  pinMode(columns[i], OUTPUT);
  pinMode(rows[i], OUTPUT);

  //turn off LEDs
  digitalWrite(columns[i], coloff);
  digitalWrite(rows[i], rowoff);
  }
}

void loop(){
  byte revbit[8] = {7,6,5,4,3,2,1,0};                       // reverse order for bits  
  for(int t = 0;t < text.length(); t++) {                   // show characters oftext
    char c = text.charAt(t);                                // one char from text
    for(int n = 5; n >= 0; n--) {                           // shift new char to right 5-4-3-2-1
      for(int m = 0; m < 8;m++) {                           // set rows
          matrix[m] = (matrix[m] << 1) | (font[c][m] >> n); // shift 1 current row to left OR with new char shift n to right 
      }
      for(int r = 0; r < 10; r++) {                         // redraw 10 times
        drawMatrix(matrix);  
        delay(1);                                             // wait for next character
      }
    }
  }
}

void drawMatrix(byte mat[8]) {
  byte revbit[8] = {7,6,5,4,3,2,1,0};                   // reverse order for bits
  for(int i = 0; i < 8; i++){                           // loop for each column
    digitalWrite(columns[i], colon);                    // ON col i
    byte row = mat[revbit[i]];                          //read bits for row   
    for(int j = 0; j < 8; j++){                         // loop for row bits    
       if(bitRead(row,j) == 1){                          //if bit j is 1, turn on LED
          digitalWrite(rows[j], rowon);
       }
    }
    delay(2);                                           //waiting, lighting short time    
    for(int j = 0; j < 8; j++){                         //OFF all rows
      digitalWrite(rows[j], rowoff);
    }
    digitalWrite(columns[i], coloff);                   // OFF column
  }
}
